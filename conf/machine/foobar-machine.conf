## conf/machine/foobar-machine.conf
```bitbake
require conf/machine/qemux86-64.conf

#IMAGE_INSTALL:append = " libfoo"
#SDKIMAGE_FEATURES:append = "staticdev-pkgs"

KMACHINE = "qemux86-64"
PREFERRED_PROVIDER_virtual/kernel:foobar-machine = "linux-yocto"
```
